## west.yml
```yaml
manifest:
  defaults:
    remote: zephyrproject-rtos

  remotes:
    - name: zephyrproject-rtos
      url-base: https://github.com/zephyrproject-rtos
    - name: nxp-upstream
      url-base: https://github.com/nxp-upstream
    - name: nxp-mcuxpresso
      url-base: https://github.com/nxp-mcuxpresso
    - name: iotconnect
      url-base: https://github.com/avnet-iotconnect
  projects:
    - name: zephyr
      remote: nxp-upstream
      revision: 86733ded7f1974fa4f254e4f69f13489f5b42cf4
      import: false
      west-commands: scripts/west-commands.yml
      import:
        # By using name-allowlist we can clone only the modules that are
        # strictly needed by the application.
        name-allowlist:
          - cmsis
          - segger
    - name: hal_nxp
      remote: nxp-upstream
      revision: 92c9061719d48dda030cf8a7cda4c47ee7f44471
      path: modules/hal/nxp
      groups:
        - hal
    - name: mcux-sdk-middleware-tensorflow
      remote: nxp-mcuxpresso
      revision: MCUX_2.16.000
      path: modules/lib/tflite-micro

    - name: iotc-c-lib
      remote: iotconnect
      revision: 550e078250c034974beec7ab4cbb30f18f40358a
      submodules: true

    # - name: iotc-generic-c-sdk
    #   remote: iotconnect
    #   revision: 1666f6a352aab604f6c5a888c94de17e800d1aed

  self:
    path: nxp
```
